## drivers/ptp_clock/Kconfig.nxp_enet_qos
```kconfig
# SPDX-FileCopyrightText: Copyright 2026 NXP
# SPDX-License-Identifier: Apache-2.0

config PTP_CLOCK_NXP_ENET_QOS
	bool "NXP ENET QoS PTP Clock driver"
	default y
	depends on DT_HAS_NXP_ENET_QOS_PTP_CLOCK_ENABLED
	depends on ETH_NXP_ENET_QOS
	select NET_L2_PTP_TIMESTAMPING
	help
	  Enable NXP ENET QoS PTP clock to support Ethernet timestamping.

config PTP_CLOCK_NXP_ENET_QOS_OUTPUT
	bool "NXP MCXN947 ENET QoS fixed PPS output"
	depends on PTP_CLOCK_NXP_ENET_QOS
	depends on PRECISION_CLOCK_OUTPUT
	depends on SOC_MCXN947
	select GPIO
	select MUX
	select MUX_NXP_INPUTMUX
	select PINCTRL
	help
	  Enable the restricted MCXN947 ENET QoS PPS0 waveform provider. The
	  provider exposes one fixed 1 Hz, one-PTP-clock pulse and gates its
	  physical pin until before the requested first edge.

	  The PTP clock devicetree node must provide pinctrl-0, a default entry in
	  pinctrl-names, mux-states, and output-gpios. The pin selected as TRIG_OUT0
	  by pinctrl-0 must be the same physical pad named by output-gpios: the
	  driver stops and gates PPS by switching that pad to GPIO and driving it
	  physically low. The mux state must route ENET PPS0 to the trigger input
	  feeding TRIG_OUT0.
```

## dts/bindings/ethernet/nxp,enet-qos-ptp-clock.yaml
```yaml
# SPDX-License-Identifier: Apache-2.0

description: |
  NXP ENET QoS Precision Time Protocol clock.

  On MCXN947, the optional fixed PPS output uses mux-states to route ENET PPS0
  to the trigger input that feeds the TRIG_OUT0 pin selected by pinctrl-0. The
  output-gpios property must name that same physical pad. The driver gates and
  stops PPS by switching the pad from TRIG_OUT0 to GPIO and driving it
  physically low.

compatible: "nxp,enet-qos-ptp-clock"

include:
  - snps,dwmac-ptp-clock.yaml
  - pinctrl-device.yaml
  - mux-consumer.yaml

properties:
  output-gpios:
    type: phandle-array
    description: |
      GPIO used to drive the externally routed PPS output physically low. This
      must name the same physical pad that pinctrl-0 selects for TRIG_OUT0.
```

## samples/net/pps_out/boards/frdm_mcxn947_mcxn947_cpu0.conf
```kconfig
CONFIG_PTP_CLOCK_NXP_ENET_QOS_OUTPUT=y
CONFIG_PRECISION_PPS_OUTPUT_WIDTH_PROVIDER_DEFAULT=y
```

## subsys/precision_timing/Kconfig
```kconfig
# SPDX-FileCopyrightText: Copyright The Zephyr Project Contributors
# SPDX-FileCopyrightText: Copyright (c) 2026 Philipp Steiner
#
# SPDX-License-Identifier: Apache-2.0

config PRECISION_TIMING
	bool "Precision timing infrastructure"
	help
	  Enable protocol-neutral precision time arithmetic, clock operations,
	  and a reusable proportional-integral controller.

	  The API is at experimental maturity as described by the Zephyr API
	  lifecycle, so it may still change. The subsystem is a building block
	  for protocols such as PTP and gPTP and does not change their maturity.

if PRECISION_TIMING

config PRECISION_TIMING_PI_KP
	int "PI controller proportional gain in thousandths"
	default 700
	range 0 10000
	help
	  Proportional gain used by the PTP and gPTP clock PI controllers,
	  expressed in thousandths. For example, 700 configures a gain of 0.7.

	  The default is suitable for a Sync interval around one second.
	  Shorter Sync intervals may require a smaller gain to avoid
	  oscillation.

config PRECISION_TIMING_PI_KI
	int "PI controller integral gain in thousandths"
	default 300
	range 0 10000
	help
	  Integral gain used by the PTP and gPTP clock PI controllers,
	  expressed in thousandths. For example, 300 configures a gain of 0.3.

	  The default is suitable for a Sync interval around one second.
	  Shorter Sync intervals may require a smaller gain to avoid
	  oscillation.

config PRECISION_CLOCK_OUTPUT
	bool "Scheduled precision clock output"
	help
	  Enable protocol-neutral scheduled clock outputs. Providers can expose
	  hardware-timed output channels that drive periodic waveforms with explicit
	  first-edge times, periods,
	  and pulse-width policies in the owning precision clock's timescale.

config PRECISION_TIMING_SHELL
	bool "Precision timing shell"
	depends on SHELL
	help
	  Enable a runtime registry and shell commands for inspecting precision
	  clocks and controlling scheduled clock outputs.

config PRECISION_TIMING_SHELL_MAX_INSTANCES
	int "Maximum number of precision timing shell instances"
	default 4
	range 1 16
	depends on PRECISION_TIMING_SHELL
	help
	  Set the fixed capacity of the precision timing shell registry.

endif # PRECISION_TIMING
```
