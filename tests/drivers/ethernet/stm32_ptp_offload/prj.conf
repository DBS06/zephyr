## CMakeLists.txt
```
# SPDX-FileCopyrightText: Copyright The Zephyr Project Contributors
# SPDX-License-Identifier: Apache-2.0

cmake_minimum_required(VERSION 3.28.0)
find_package(Zephyr REQUIRED HINTS $ENV{ZEPHYR_BASE})
project(stm32_ptp_offload)

target_sources(app PRIVATE
  src/main.c
  src/driver.c
)
target_include_directories(app PRIVATE "${ZEPHYR_BASE}/drivers/ethernet")
if(CONFIG_TEST_STM32_TX_ASYNC)
  target_compile_definitions(app PRIVATE CONFIG_ETH_STM32_HAL_TX_ASYNC=1)
endif()
```

## Kconfig
```
# SPDX-FileCopyrightText: Copyright The Zephyr Project Contributors
# SPDX-License-Identifier: Apache-2.0

mainmenu "STM32 PTP offload tests"

config TEST_STM32_TX_ASYNC
	bool "Exercise asynchronous transmission"

source "Kconfig.zephyr"
```

## prj.conf
```kconfig
# SPDX-FileCopyrightText: Copyright The Zephyr Project Contributors
# SPDX-License-Identifier: Apache-2.0

CONFIG_ZTEST=y
# Keep the driver's 100 us polls well below its 20 ms drain deadline.
CONFIG_SYS_CLOCK_TICKS_PER_SEC=10000
CONFIG_NETWORKING=y
CONFIG_NET_L2_ETHERNET=y
CONFIG_NET_IPV6=n
CONFIG_NET_IPV4=y
CONFIG_PTP_CLOCK=y
CONFIG_NET_ETHERNET_PTP_OFFLOAD=y
```

## src/main.c
```c
/*
 * SPDX-FileCopyrightText: Copyright The Zephyr Project Contributors
 * SPDX-License-Identifier: Apache-2.0
 */

#include <zephyr/ztest.h>
#include <zephyr/logging/log.h>
#include "eth_stm32_hal_ptp_offload.h"

LOG_MODULE_REGISTER(eth_stm32_hal, CONFIG_ETHERNET_LOG_LEVEL);

static const uint8_t mac[6] = {2, 3, 4, 5, 6, 7};

static void make_frame(uint8_t frame[68], uint8_t type)
{
	memset(frame, 0, 68);
	memcpy(frame, mac, 6);
	sys_put_be16(0x88f7, frame + 12);
	frame[14] = type;
	frame[15] = 2;
	sys_put_be16(type == 0 || type == 1 ? 44 : 54, frame + 16);
	frame[34] = 0xa5;
}

ZTEST(stm32_ptp_offload, test_sync_context_and_clear)
{
	struct ethernet_ptp_config cfg = {
		.operations = ETHERNET_PTP_ONE_STEP_SYNC,
		.generation = 5,
		.transmitter = 1,
		.port_id = {0xa5},
	};
	struct net_ptp_packet meta = {.flags = NET_PTP_PACKET_ONE_STEP, .generation = 5};
	uint8_t frame[68];
	uint32_t desc[4];

	make_frame(frame, 0);
	zassert_ok(stm32_ptp_context(&cfg, &meta, frame, 60, desc));
	zassert_equal(desc[3], BIT(30) | BIT(27));
	zassert_equal(desc[0] | desc[1] | desc[2], 0);
	meta.flags = 0;
	zassert_ok(stm32_ptp_context(&cfg, &meta, frame, 60, desc));
	zassert_equal(desc[3], BIT(30), "one-step state must not leak to the next packet");
	meta.flags = NET_PTP_PACKET_RX_VALID | NET_PTP_PACKET_RX_RESPONDED;
	meta.generation--;
	zassert_ok(stm32_ptp_context(&cfg, &meta, frame, 60, desc));
	zassert_equal(desc[3], BIT(30), "forwarded RX metadata must not request insertion");
}

ZTEST(stm32_ptp_offload, test_peer_context_and_invalid_ingress)
{
	struct ethernet_ptp_config cfg = {
		.operations = ETHERNET_PTP_ONE_STEP_PDELAY_RESP,
		.generation = 9,
		.p2p = 1,
		.port_id = {0xa5},
	};
	struct net_ptp_packet meta = {
		.flags = NET_PTP_PACKET_ONE_STEP | NET_PTP_PACKET_INGRESS_VALID,
		.generation = 9,
		.ingress_seconds = UINT32_MAX,
		.ingress_nanoseconds = 999999999,
	};
	uint8_t frame[68];
	uint32_t desc[4];

	make_frame(frame, 3);
	zassert_ok(stm32_ptp_context(&cfg, &meta, frame, sizeof(frame), desc));
	zassert_equal(desc[3], BIT(30) | BIT(27) | BIT(26));
	zassert_equal(desc[0], 999999999);
	zassert_equal(desc[1], UINT32_MAX);
	meta.ingress_seconds++;
	zassert_equal(stm32_ptp_context(&cfg, &meta, frame, sizeof(frame), desc), -ENOTSUP);
	meta.ingress_seconds = 1;
	meta.ingress_nanoseconds++;
	zassert_equal(stm32_ptp_context(&cfg, &meta, frame, sizeof(frame), desc), -ENOTSUP);
	meta.generation--;
	zassert_equal(stm32_ptp_context(&cfg, &meta, frame, sizeof(frame), desc), -ESTALE);
}

ZTEST(stm32_ptp_offload, test_response_ownership_is_exchange_specific)
{
	struct ethernet_ptp_config cfg = {.operations = ETHERNET_PTP_AUTO_DELAY_RESP};
	uint8_t frame[68];

	make_frame(frame, 1);
	zassert_true(stm32_ptp_response_owned(&cfg, frame, 60, mac));
	frame[20] = BIT(1);
	zassert_false(stm32_ptp_response_owned(&cfg, frame, 60, mac));
	frame[20] = 0;
	frame[18] = 1;
	zassert_false(stm32_ptp_response_owned(&cfg, frame, 60, mac));
	frame[18] = 0;
	frame[14] |= 0x10;
	zassert_false(stm32_ptp_response_owned(&cfg, frame, 60, mac));
	make_frame(frame, 2);
	zassert_false(stm32_ptp_response_owned(&cfg, frame, sizeof(frame), mac));
	cfg.operations = ETHERNET_PTP_AUTO_PDELAY_RESP;
	zassert_true(stm32_ptp_response_owned(&cfg, frame, sizeof(frame), mac));
	frame[0] = 0xff;
	zassert_false(stm32_ptp_response_owned(&cfg, frame, sizeof(frame), mac));
}

ZTEST(stm32_ptp_offload, test_response_ownership_matches_mac_receive_filter)
{
	static const uint8_t destinations[][6] = {
		{2, 3, 4, 5, 6, 7},
		{1, 0x1b, 0x19, 0, 0, 0},
		{1, 0x80, 0xc2, 0, 0, 0x0e},
	};
	static const uint16_t tags[] = {0, 0xa000, 42};
	struct ethernet_ptp_config cfg = {0};
	uint8_t frame[72];

	for (uint8_t type = 1; type <= 2; type++) {
		cfg.operations = type == 1 ? ETHERNET_PTP_AUTO_DELAY_RESP
					   : ETHERNET_PTP_AUTO_PDELAY_RESP;
		for (size_t dst = 0; dst < ARRAY_SIZE(destinations); dst++) {
			make_frame(frame, type);
			memcpy(frame, destinations[dst], 6);
			zassert_true(stm32_ptp_response_owned(&cfg, frame, 68, mac));

			/* The MAC accepts either multicast address for either request,
			 * including priority-tagged frames delivered to the physical port.
			 */
			memmove(frame + 16, frame + 12, 56);
			sys_put_be16(0x8100, frame + 12);
			for (size_t tag = 0; tag < ARRAY_SIZE(tags); tag++) {
				sys_put_be16(tags[tag], frame + 14);
				zassert_true(stm32_ptp_response_owned(&cfg, frame, sizeof(frame),
							     mac));
			}
		}
	}

	for (size_t len = 0; len < 52; len++) {
		zassert_false(stm32_ptp_response_owned(&cfg, frame, len, mac));
	}
	frame[24] = BIT(1);
	zassert_false(stm32_ptp_response_owned(&cfg, frame, sizeof(frame), mac));
	frame[24] = 0;
	frame[22] = 1;
	zassert_false(stm32_ptp_response_owned(&cfg, frame, sizeof(frame), mac));
	frame[22] = 0;
	frame[18] |= 0x10;
	zassert_false(stm32_ptp_response_owned(&cfg, frame, sizeof(frame), mac));
	frame[18] = 2;
	frame[19] = 1;
	zassert_false(stm32_ptp_response_owned(&cfg, frame, sizeof(frame), mac));
	frame[19] = 2;
	memcpy(frame + 38, cfg.port_id, sizeof(cfg.port_id));
	zassert_false(stm32_ptp_response_owned(&cfg, frame, sizeof(frame), mac));
}

ZTEST(stm32_ptp_offload, test_unsupported_frame_never_gets_one_step_context)
{
	struct ethernet_ptp_config cfg = {
		.operations = ETHERNET_PTP_ONE_STEP_SYNC,
		.generation = 1,
		.port_id = {0xa5},
	};
	struct net_ptp_packet meta = {.flags = NET_PTP_PACKET_ONE_STEP, .generation = 1};
	uint8_t frame[68];
	uint32_t desc[4];

	make_frame(frame, 0);
	zassert_equal(stm32_ptp_context(&cfg, &meta, frame, 47, desc), -EINVAL);
	frame[20] = BIT(1);
	zassert_equal(stm32_ptp_context(&cfg, &meta, frame, 60, desc), -EINVAL);
	make_frame(frame, 0);
	frame[34]++;
	zassert_equal(stm32_ptp_context(&cfg, &meta, frame, 60, desc), -EINVAL);
	make_frame(frame, 0);
	sys_put_be16(0x8100, frame + 12);
	zassert_equal(stm32_ptp_context(&cfg, &meta, frame, 60, desc), -EINVAL);
	make_frame(frame, 0);
	sys_put_be16(0x0800, frame + 12);
	zassert_equal(stm32_ptp_context(&cfg, &meta, frame, 60, desc), -EINVAL);
}

ZTEST(stm32_ptp_offload, test_hardware_mode_limits)
{
	struct ethernet_ptp_config cfg = {.operations = ETHERNET_PTP_AUTO_SYNC, .transmitter = 1};

	zassert_ok(stm32_ptp_validate(&cfg));
	cfg.log_sync_interval = -1;
	zassert_equal(stm32_ptp_validate(&cfg), -ENOTSUP);
	cfg.log_sync_interval = 0;
	cfg.sync_flags = 8;
	zassert_equal(stm32_ptp_validate(&cfg), -ENOTSUP);
	cfg.sync_flags = 0;
	cfg.p2p = 1;
	zassert_equal(stm32_ptp_validate(&cfg), -ENOTSUP);
	cfg.operations |= ETHERNET_PTP_AUTO_PDELAY_RESP;
	zassert_ok(stm32_ptp_validate(&cfg));
	cfg.operations = ETHERNET_PTP_AUTO_DELAY_RESP;
	zassert_equal(stm32_ptp_validate(&cfg), -ENOTSUP);
	cfg.p2p = 0;
	cfg.log_delay_req_interval = 6;
	zassert_equal(stm32_ptp_validate(&cfg), -ENOTSUP);
	cfg.log_delay_req_interval = 5;
	zassert_ok(stm32_ptp_validate(&cfg));
}

ZTEST_SUITE(stm32_ptp_offload, NULL, NULL, NULL, NULL, NULL);
```

## src/driver.c
```c
/*
 * SPDX-FileCopyrightText: Copyright The Zephyr Project Contributors
 * SPDX-License-Identifier: Apache-2.0
 */

#define net_if_add_tx_timestamp test_add_tx_timestamp
#define net_recv_data           test_recv_data
#include "mock_hal.h"
#include "eth_stm32_hal_ptp_offload.c"
#include <zephyr/ztest.h>

static struct eth_stm32_dma_buf buffers;
static ETH_DMADescTypeDef descriptors[ETH_TX_DESC_CNT];
static ETH_TypeDef registers;
static struct eth_stm32_hal_dev_data data;
static const struct eth_stm32_hal_dev_cfg config = {.dma_buf = &buffers};
static const struct device dev = {.data = &data, .config = &config};
static struct net_pkt *pending_rx;
static struct net_pkt *pending_final_rx;
static struct net_ptp_packet received_meta;
static int timestamp_count;
static bool complete_on_publish;
static bool fault_during_drain;
static uint32_t completion_status;
static int dropped_rx_pending;
static bool partial_rx_pending;
static int received_count;
static bool reject_receive;
static bool read_config_on_receive;
static int receive_config_result;
static int reader_result;
static bool tx_worker_blocked;
static struct ethernet_config reader_config;
static struct k_thread reader_thread;
static K_THREAD_STACK_DEFINE(reader_stack, 1536);
static K_SEM_DEFINE(reader_start, 0, 1);
static K_SEM_DEFINE(reader_done, 0, 1);

static void config_reader(void *p1, void *p2, void *p3)
{
	ARG_UNUSED(p1);
	ARG_UNUSED(p2);
	ARG_UNUSED(p3);
	k_sem_take(&reader_start, K_FOREVER);
	reader_result =
		eth_stm32_ptp_offload_get(&dev, NULL, ETHERNET_CONFIG_TYPE_PTP, &reader_config);
	k_sem_give(&reader_done);
}

void test_add_tx_timestamp(struct net_pkt *pkt)
{
	zassert_equal(pkt->timestamp.second, 7);
	zassert_equal(pkt->timestamp.nanosecond, 42);
	timestamp_count++;
}

int test_recv_data(struct net_if *iface, struct net_pkt *pkt)
{
	ARG_UNUSED(iface);
	received_meta = pkt->ptp;
	received_count++;
	if (read_config_on_receive) {
		read_config_on_receive = false;
		k_sem_give(&reader_start);
		/* A synchronous RX consumer must not block another thread's get_config. */
		receive_config_result = k_sem_take(&reader_done, K_MSEC(100));
	}
	if (reject_receive) {
		return -ENOBUFS;
	}
	net_pkt_unref(pkt);
	return 0;
}

struct net_pkt *eth_stm32_rx_locked(const struct device *device)
{
	struct net_pkt *pkt = pending_rx;

	if (dropped_rx_pending > 0) {
		dropped_rx_pending--;
		return NULL;
	}
	pending_rx = NULL;
	if (pkt == NULL && (registers.DMACRCR & ETH_DMACRCR_SR) == 0U) {
		pkt = pending_final_rx;
		pending_final_rx = NULL;
	}
	if (fault_during_drain) {
		eth_stm32_ptp_offload_fault(&data);
	}
	if (pkt != NULL) {
		eth_stm32_ptp_offload_rx(device, pkt);
	}
	return pkt;
}

bool eth_stm32_rx_pending(const struct device *device)
{
	ARG_UNUSED(device);
	return dropped_rx_pending != 0 || partial_rx_pending;
}

static void complete_tx(void)
{
	for (size_t i = 0; i < ETH_TX_DESC_CNT; i++) {
		if (data.ptp_tx_pkt[i] != NULL) {
			descriptors[i].DESC0 = 42;
			descriptors[i].DESC1 = 7;
			descriptors[i].DESC3 = completion_status;
		} else {
			descriptors[i].DESC3 &= ~ETH_DMATXNDESCRF_OWN;
		}
	}
}

static void test_dma_barrier(void)
{
	if (complete_on_publish) {
		complete_tx();
	}
}

static struct net_pkt *packet(bool one_step)
{
	uint8_t frame[68] = {0};
	struct net_pkt *pkt =
		net_pkt_alloc_with_buffer(NULL, sizeof(frame), NET_AF_UNSPEC, 0, K_NO_WAIT);

	zassert_not_null(pkt);
	sys_put_be16(0x88f7, frame + 12);
	frame[15] = 2;
	sys_put_be16(44, frame + 16);
	zassert_ok(net_pkt_write(pkt, frame, sizeof(frame)));
	net_pkt_cursor_init(pkt);
	if (one_step) {
		pkt->ptp.flags = NET_PTP_PACKET_ONE_STEP;
		pkt->ptp.generation = data.ptp_config.generation;
	}
	return pkt;
}

static void block_tx_worker(void)
{
	/* Keep the system worker out of deterministic descriptor tests only. */
	k_mutex_lock(&data.ptp_lock, K_FOREVER);
	tx_worker_blocked = true;
}

static void unblock_tx_worker(void)
{
	zassert_ok(k_mutex_unlock(&data.ptp_lock));
	tx_worker_blocked = false;
}

static void driver_before(void *fixture)
{
	ARG_UNUSED(fixture);
	memset(&data, 0, sizeof(data));
	memset(&registers, 0, sizeof(registers));
	memset(descriptors, 0, sizeof(descriptors));
	data.heth.Instance = &registers;
	data.heth.Init.TxDesc = descriptors;
	data.heth.gState = HAL_ETH_STATE_STARTED;
	eth_stm32_ptp_offload_init(&dev);
	data.ptp_stopping = false;
	data.ptp_config.operations = ETHERNET_PTP_ONE_STEP_SYNC;
	k_sem_init(&data.tx_int_sem, 0, 1);
	pending_rx = NULL;
	pending_final_rx = NULL;
	memset(&received_meta, 0, sizeof(received_meta));
	complete_on_publish = !IS_ENABLED(CONFIG_ETH_STM32_HAL_TX_ASYNC);
	fault_during_drain = false;
	completion_status = 0;
	timestamp_count = 0;
	dropped_rx_pending = 0;
	partial_rx_pending = false;
	received_count = 0;
	reject_receive = false;
	tx_worker_blocked = false;
	read_config_on_receive = false;
	receive_config_result = -EINPROGRESS;
	reader_result = -EINPROGRESS;
	memset(&reader_config, 0, sizeof(reader_config));
	k_sem_reset(&reader_start);
	k_sem_reset(&reader_done);
}

static void driver_after(void *fixture)
{
	struct k_work_sync sync;

	ARG_UNUSED(fixture);
	k_work_cancel_delayable_sync(&data.ptp_tx_work, &sync);
	if (tx_worker_blocked) {
		/* An assertion can terminate the test thread while it owns the mutex.
		 * The owner has exited and the only other user, tx_work, is canceled.
		 */
		k_mutex_init(&data.ptp_lock);
		tx_worker_blocked = false;
	}
	zassert_ok(eth_stm32_ptp_offload_stop(&dev));
}

ZTEST(stm32_ptp_driver, test_wrap_completion_and_context_clear)
{
	block_tx_worker();
	for (size_t n = 0; n < ETH_TX_DESC_CNT * 2; n++) {
		bool one_step = n % 2 == 0;
		struct net_pkt *pkt = packet(one_step);
		uint16_t first = data.ptp_tx_head;
		uint16_t last = next_desc(first);

		net_pkt_set_tx_timestamping(pkt, true);
		completion_status = one_step ? 0 : ETH_DMATXNDESCWBF_TTSS;
		zassert_ok(eth_stm32_ptp_offload_tx(&dev, pkt));
		zassert_equal(descriptors[first].DESC3 & STM32_PTP_OSTC,
			      one_step ? STM32_PTP_OSTC : 0);
		zassert_equal(descriptors[last].DESC2 & ETH_DMATXNDESCRF_TTSE,
			      one_step ? 0 : ETH_DMATXNDESCRF_TTSE);
		complete_tx();
		reap_tx(&data);
		zassert_equal(data.ptp_tx_used, 0);
		zassert_is_null(data.ptp_tx_pkt[last]);
		net_pkt_unref(pkt);
	}
	zassert_equal(timestamp_count, ETH_TX_DESC_CNT);
	unblock_tx_worker();
}

ZTEST(stm32_ptp_driver, test_exhaustion_timeout_retains_owned_buffers)
{
	struct net_pkt *pkt = packet(false);
	int result;

	block_tx_worker();
	complete_on_publish = false;
	net_pkt_set_tx_timestamping(pkt, true);
	result = eth_stm32_ptp_offload_tx(&dev, pkt);
	if (IS_ENABLED(CONFIG_ETH_STM32_HAL_TX_ASYNC)) {
		zassert_ok(result);
		net_pkt_cursor_init(pkt);
		zassert_ok(eth_stm32_ptp_offload_tx(&dev, pkt));
		net_pkt_cursor_init(pkt);
		zassert_equal(eth_stm32_ptp_offload_tx(&dev, pkt), -ETIMEDOUT);
	} else {
		zassert_equal(result, -ETIMEDOUT);
	}
	zassert_not_equal(data.ptp_tx_used, 0);
	zassert_not_null(data.ptp_tx_pkt[1]);
	zassert_equal(registers.MACPOCR, 0);
	completion_status = ETH_DMATXNDESCWBF_TTSS;
	complete_tx();
	reap_tx(&data);
	zassert_equal(timestamp_count, 0, "abandoned exchanges must not get late callbacks");
	zassert_equal(data.ptp_tx_used, 0);
	zassert_is_null(data.ptp_tx_pkt[1]);
	/* A fault disables acceleration, not subsequent ordinary transmission. */
	complete_on_publish = true;
	net_pkt_cursor_init(pkt);
	zassert_ok(eth_stm32_ptp_offload_tx(&dev, pkt));
	reap_tx(&data);
	net_pkt_unref(pkt);
	unblock_tx_worker();
}

ZTEST(stm32_ptp_driver, test_dma_error_disables_offload_without_timestamp_callback)
{
	struct net_pkt *pkt = packet(false);
	struct ethernet_config effective;
	int result;

	block_tx_worker();
	completion_status = ETH_DMATXNDESCWBF_ES;
	net_pkt_set_tx_timestamping(pkt, true);
	result = eth_stm32_ptp_offload_tx(&dev, pkt);
	zassert_equal(result, IS_ENABLED(CONFIG_ETH_STM32_HAL_TX_ASYNC) ? 0 : -EIO);
	complete_tx();
	reap_tx(&data);
	zassert_equal(timestamp_count, 0);
	zassert_true(atomic_get(&data.ptp_fault));
	zassert_ok(eth_stm32_ptp_offload_get(&dev, NULL, ETHERNET_CONFIG_TYPE_PTP, &effective));
	zassert_equal(effective.ptp.capabilities, 0);
	pkt->ptp.flags = NET_PTP_PACKET_ONE_STEP;
	net_pkt_cursor_init(pkt);
	zassert_equal(eth_stm32_ptp_offload_tx(&dev, pkt), -EIO);
	net_pkt_unref(pkt);
	unblock_tx_worker();
}

ZTEST(stm32_ptp_driver, test_configuration_identity_and_clock_preservation)
{
	struct ethernet_ptp_config requested = {
		.operations = ETHERNET_PTP_AUTO_SYNC | ETHERNET_PTP_AUTO_DELAY_RESP,
		.port_id = {0, 1, 2, 3, 4, 5, 6, 7, 8, 9},
		.domain = 17,
		.transmitter = 1,
		.log_sync_interval = 1,
		.log_delay_req_interval = 3,
	};
	/* Clock enable, fine adjustment, digital rollover and RX-all timestamping. */
	uint32_t clock_bits = BIT(0) | BIT(1) | BIT(8) | BIT(9);
	struct ethernet_config effective;

	/* Startup/link-down defers negotiation instead of failing port startup. */
	data.ptp_stopping = true;
	zassert_ok(eth_stm32_ptp_offload_get(&dev, NULL, ETHERNET_CONFIG_TYPE_PTP, &effective));
	zassert_equal(effective.ptp.capabilities, 0);
	data.ptp_stopping = false;
	zassert_ok(eth_stm32_ptp_offload_get(&dev, NULL, ETHERNET_CONFIG_TYPE_PTP, &effective));
	zassert_equal(effective.ptp.capabilities, STM32_PTP_CAPS);

	registers.MACTSCR = clock_bits;
	registers.MACCR = ETH_MACCR_RE;
	registers.DMACRCR = ETH_DMACRCR_SR;
	zassert_ok(eth_stm32_ptp_offload_configure(&dev, &requested));
	zassert_equal(registers.MACSPI0R, 0x06070809);
	zassert_equal(registers.MACSPI1R, 0x02030405);
	zassert_equal(registers.MACSPI2R, 0x0001);
	zassert_equal(registers.MACLMIR, 0x0201);
	zassert_equal(registers.MACPOCR, (17U << 8) | BIT(1) | BIT(0));
	zassert_equal(registers.MACTSCR & clock_bits, clock_bits);
	zassert_equal(registers.MACCR, ETH_MACCR_RE);
	zassert_equal(registers.DMACRCR, ETH_DMACRCR_SR);
	zassert_equal(data.ptp_config.generation, 2);

	requested.operations = ETHERNET_PTP_AUTO_PDELAY_RESP;
	requested.transmitter = 0;
	requested.p2p = 1;
	zassert_ok(eth_stm32_ptp_offload_configure(&dev, &requested));
	zassert_equal(registers.MACPOCR, (17U << 8) | BIT(6) | BIT(0));
	zassert_equal(registers.MACTSCR & ETH_MACTSCR_SNAPTYPSEL, BIT(16));
	zassert_equal(registers.MACTSCR & ETH_MACTSCR_TSMSTRENA, 0);
}

ZTEST(stm32_ptp_driver, test_queued_rx_retains_old_ownership_and_tx_rejects_old_epoch)
{
	struct ethernet_ptp_config disabled = {0};
	struct net_pkt *stale = packet(true);
	uint8_t type = 1;
	uint8_t source = 1;

	data.ptp_config.operations |= ETHERNET_PTP_AUTO_DELAY_RESP;
	pending_rx = packet(false);
	net_pkt_set_overwrite(pending_rx, true);
	zassert_ok(net_pkt_skip(pending_rx, 14));
	zassert_ok(net_pkt_write(pending_rx, &type, 1));
	zassert_ok(net_pkt_skip(pending_rx, 19));
	zassert_ok(net_pkt_write(pending_rx, &source, 1));
	zassert_ok(eth_stm32_ptp_offload_configure(&dev, &disabled));
	zassert_equal(received_meta.generation, 1);
	zassert_equal(received_meta.flags, NET_PTP_PACKET_RX_VALID | NET_PTP_PACKET_RX_RESPONDED);
	zassert_equal(data.ptp_config.generation, 2);
	zassert_equal(eth_stm32_ptp_offload_tx(&dev, stale), -ESTALE);
	zassert_equal(data.ptp_tx_used, 0);
	net_pkt_unref(stale);
}

ZTEST(stm32_ptp_driver, test_priority_tagged_rx_marks_hardware_response)
{
	uint8_t frame[72] = {1, 0x80, 0xc2, 0, 0, 0x0e};
	struct net_pkt *pkt =
		net_pkt_alloc_with_buffer(NULL, sizeof(frame), NET_AF_UNSPEC, 0, K_NO_WAIT);

	zassert_not_null(pkt);
	data.ptp_config.operations = ETHERNET_PTP_AUTO_DELAY_RESP;
	data.ptp_config.domain = 17;
	sys_put_be16(0x8100, frame + 12);
	sys_put_be16(0xa000, frame + 14); /* PCP 5, VID 0: delivered to the physical port. */
	sys_put_be16(0x88f7, frame + 16);
	frame[18] = 1; /* Delay_Req to the peer-delay multicast address. */
	frame[19] = 2;
	sys_put_be16(44, frame + 20);
	frame[22] = 17;
	frame[38] = 1;
	zassert_ok(net_pkt_write(pkt, frame, sizeof(frame)));
	eth_stm32_ptp_offload_rx(&dev, pkt);
	zassert_equal(pkt->ptp.flags, NET_PTP_PACKET_RX_VALID | NET_PTP_PACKET_RX_RESPONDED);
	zassert_equal(pkt->ptp.generation, data.ptp_config.generation);
	zassert_ok(net_pkt_read(pkt, frame, sizeof(frame)), "RX must restore the packet cursor");
	zassert_equal(frame[18], 1);

	data.ptp_config.operations = 0;
	eth_stm32_ptp_offload_rx(&dev, pkt);
	zassert_equal(pkt->ptp.flags, NET_PTP_PACKET_RX_VALID);
	net_pkt_unref(pkt);
}

ZTEST(stm32_ptp_driver, test_fault_during_reconfiguration_cannot_reenable_generator)
{
	struct ethernet_ptp_config requested = {
		.operations = ETHERNET_PTP_AUTO_SYNC,
		.transmitter = 1,
	};

	fault_during_drain = true;
	zassert_equal(eth_stm32_ptp_offload_configure(&dev, &requested), -EIO);
	zassert_equal(registers.MACPOCR, 0);
	zassert_equal(data.ptp_config.generation, 1);
}

ZTEST(stm32_ptp_driver, test_reconfiguration_timeout_does_not_change_generation)
{
	struct ethernet_ptp_config disabled = {0};

	registers.MACDR = ETH_MACDR_RPESTS;
	registers.MACPOCR = ETH_MACPOCR_PTOEN;
	zassert_equal(eth_stm32_ptp_offload_configure(&dev, &disabled), -ETIMEDOUT);
	zassert_equal(registers.MACPOCR, 0);
	zassert_equal(data.ptp_config.generation, 1);
}

ZTEST(stm32_ptp_driver, test_hal_error_cannot_relabel_undrainable_rx_generation)
{
	struct ethernet_ptp_config disabled = {0};

	data.ptp_config.operations = ETHERNET_PTP_AUTO_DELAY_RESP;
	data.heth.gState = 0;
	registers.MACPOCR = ETH_MACPOCR_PTOEN;
	zassert_equal(eth_stm32_ptp_offload_configure(&dev, &disabled), -EIO);
	zassert_equal(registers.MACPOCR, 0);
	zassert_equal(data.ptp_config.generation, 1);
	zassert_equal(data.ptp_config.operations, ETHERNET_PTP_AUTO_DELAY_RESP);
}

ZTEST(stm32_ptp_driver, test_rx_allocation_failures_do_not_end_drain_early)
{
	struct ethernet_ptp_config disabled = {0};

	dropped_rx_pending = 3;
	zassert_ok(eth_stm32_ptp_offload_configure(&dev, &disabled));
	zassert_equal(dropped_rx_pending, 0);
	partial_rx_pending = true;
	zassert_equal(eth_stm32_ptp_offload_configure(&dev, &disabled), -ETIMEDOUT);
	zassert_equal(data.ptp_config.generation, 2);
}

static struct net_pkt *delay_request(void)
{
	struct net_pkt *pkt = packet(false);
	uint8_t type = 1;
	uint8_t source = 1;

	net_pkt_set_overwrite(pkt, true);
	zassert_ok(net_pkt_skip(pkt, 14));
	zassert_ok(net_pkt_write(pkt, &type, 1));
	zassert_ok(net_pkt_skip(pkt, 19));
	zassert_ok(net_pkt_write(pkt, &source, 1));
	return pkt;
}

static void check_drain_delivery(bool stop, bool timeout, bool reject)
{
	struct ethernet_ptp_config disabled = {0};
	struct net_pkt *first = delay_request();
	struct net_pkt *last = delay_request();
	bool drain_timeout = timeout && !stop;
	int ret;
	int refs_first;
	int refs_last;
	int deliveries;

	data.ptp_config.operations = ETHERNET_PTP_AUTO_DELAY_RESP;
	registers.MACCR = ETH_MACCR_RE;
	registers.DMACRCR = ETH_DMACRCR_SR;
	if (timeout) {
		if (stop) {
			registers.DMADSR = ETH_DMADSR_TPS;
		} else {
			registers.MACDR = ETH_MACDR_RPESTS;
		}
	}
	pending_rx = net_pkt_ref(first);
	/* Exercise the final read after the RX DMA has been stopped as well. */
	pending_final_rx = drain_timeout ? NULL : net_pkt_ref(last);
	reject_receive = reject;
	read_config_on_receive = true;
	k_thread_create(&reader_thread, reader_stack, K_THREAD_STACK_SIZEOF(reader_stack),
			config_reader, NULL, NULL, NULL, K_PRIO_PREEMPT(0), 0, K_NO_WAIT);
	ret = stop ? eth_stm32_ptp_offload_stop(&dev) :
		     eth_stm32_ptp_offload_configure(&dev, &disabled);
	/* Let a blocked reader exit even when delivery held the driver mutex,
	 * or when a broken stop path did not deliver its pending packets.
	 */
	k_sem_give(&reader_start);
	zassert_ok(k_thread_join(&reader_thread, K_SECONDS(1)));
	refs_first = atomic_get(&first->atomic_ref);
	refs_last = atomic_get(&last->atomic_ref);
	deliveries = received_count;
	registers.DMADSR = 0;
	if (pending_rx != NULL) {
		net_pkt_unref(pending_rx);
		pending_rx = NULL;
	}
	if (pending_final_rx != NULL) {
		net_pkt_unref(pending_final_rx);
		pending_final_rx = NULL;
	}
	net_pkt_unref(first);
	net_pkt_unref(last);
	zassert_equal(ret, timeout ? -ETIMEDOUT : 0);
	zassert_equal(deliveries, drain_timeout ? 1 : 2);
	zassert_ok(receive_config_result,
		   "RX delivery blocked a concurrent driver's get_config");
	zassert_ok(reader_result);
	zassert_equal(refs_first, 1, "drained packet reference leaked");
	zassert_equal(refs_last, 1, "final drained packet reference leaked");
	zassert_equal(received_meta.generation, 1);
	zassert_equal(received_meta.flags, NET_PTP_PACKET_RX_VALID | NET_PTP_PACKET_RX_RESPONDED);
	zassert_equal(data.ptp_config.generation, drain_timeout ? 1 : 2);
	zassert_equal(reader_config.ptp.generation, drain_timeout ? 1 : 2);
	zassert_equal(reader_config.ptp.operations,
		      drain_timeout ? ETHERNET_PTP_AUTO_DELAY_RESP : 0);
	zassert_equal(reader_config.ptp.capabilities, stop || timeout ? 0 : STM32_PTP_CAPS);
	if (stop) {
		zassert_true(data.ptp_stopping);
		zassert_not_equal(data.heth.gState, HAL_ETH_STATE_STARTED);
	}
}

ZTEST(stm32_ptp_driver, test_configure_delivers_rx_without_blocking_config_reader)
{
	check_drain_delivery(false, false, false);
}

ZTEST(stm32_ptp_driver, test_stop_delivers_rx_without_blocking_config_reader)
{
	check_drain_delivery(true, false, false);
}

ZTEST(stm32_ptp_driver, test_configure_timeout_delivers_rx_and_releases_rejected_packet)
{
	check_drain_delivery(false, true, true);
}

ZTEST(stm32_ptp_driver, test_stop_releases_rejected_drained_packets)
{
	check_drain_delivery(true, false, true);
}

ZTEST(stm32_ptp_driver, test_configure_releases_rejected_drained_packets)
{
	check_drain_delivery(false, false, true);
}

ZTEST(stm32_ptp_driver, test_stop_dma_timeout_delivers_rx_and_releases_rejected_packets)
{
	check_drain_delivery(true, true, true);
}

ZTEST_SUITE(stm32_ptp_driver, NULL, NULL, driver_before, driver_after, NULL);
```

## src/mock_hal.h
```c
/*
 * SPDX-FileCopyrightText: Copyright The Zephyr Project Contributors
 * SPDX-License-Identifier: Apache-2.0
 */

#ifndef STM32_PTP_MOCK_HAL_H_
#define STM32_PTP_MOCK_HAL_H_

/* Replace only the MMIO/HAL boundary, compiling the production driver below it. */
#define ZEPHYR_DRIVERS_ETHERNET_ETH_STM32_HAL_PRIV_H_

#include <zephyr/kernel.h>
#include <zephyr/net/ethernet.h>

#define ETH_TX_DESC_CNT            5
#define ETH_STM32_TX_BUF_SIZE      1536
#define HAL_ETH_STATE_STARTED      1
#define ETH_DMATXCDESC_OSTC        BIT(27)
#define ETH_DMATXCDESC_CDE         BIT(23)
#define ETH_DMATXNDESCRF_OWN       BIT(31)
#define ETH_DMATXNDESCRF_IOC       BIT(31)
#define ETH_DMATXNDESCRF_TTSE      BIT(30)
#define ETH_DMATXNDESCRF_FD        BIT(29)
#define ETH_DMATXNDESCRF_LD        BIT(28)
#define ETH_DMATXNDESCWBF_ES       BIT(15)
#define ETH_DMATXNDESCWBF_TTSS     BIT(17)
#define ETH_DMACSR_TBU             BIT(2)
#define ETH_MACCR_RE               BIT(0)
#define ETH_DMACRCR_SR             BIT(0)
#define ETH_DMADSR_RPS             GENMASK(11, 8)
#define ETH_DMADSR_TPS             GENMASK(15, 12)
#define ETH_MACDR_RPESTS           BIT(0)
#define ETH_MACDR_TPESTS           BIT(16)
#define ETH_MTLRQDR_PRXQ           GENMASK(29, 16)
#define ETH_MTLRQDR_RXQSTS         GENMASK(5, 4)
#define ETH_MTLTQDR_TXQSTS         BIT(4)
#define ETH_MACTSCR_TSENMACADDR    BIT(18)
#define ETH_MACTSCR_SNAPTYPSEL_Pos 16
#define ETH_MACTSCR_SNAPTYPSEL     GENMASK(17, 16)
#define ETH_MACTSCR_TSMSTRENA      BIT(15)
#define ETH_MACTSCR_TSEVNTENA      BIT(14)
#define ETH_MACTSCR_TSIPENA        BIT(11)
#define ETH_MACTSCR_TSVER2ENA      BIT(10)
#define ETH_MACPOCR_DN_Pos         8
#define ETH_MACPOCR_DRRDIS         BIT(6)
#define ETH_MACPOCR_ASYNCEN        BIT(1)
#define ETH_MACPOCR_PTOEN          BIT(0)
#define ETH_MACLMIR_DRSYNCR_Pos    8

#define MODIFY_REG(reg, mask, value) ((reg) = ((reg) & ~(mask)) | (value))
#define __DMB()                      compiler_barrier()
#define __DSB()                      test_dma_barrier()

typedef struct {
	volatile uint32_t DESC0, DESC1, DESC2, DESC3;
} ETH_DMADescTypeDef;

typedef struct {
	uint32_t MACPOCR, MACCR, DMACRCR, DMADSR, MACDR, MTLRQDR, MTLTQDR;
	uint32_t MACTSCR, MACSPI0R, MACSPI1R, MACSPI2R, MACLMIR;
	uint32_t DMACSR, DMACTDLAR, DMACTDTPR;
} ETH_TypeDef;

typedef enum {
	HAL_OK,
	HAL_ERROR,
} HAL_StatusTypeDef;

typedef struct {
	ETH_TypeDef *Instance;
	struct {
		ETH_DMADescTypeDef *TxDesc;
	} Init;
	int gState;
} ETH_HandleTypeDef;

static inline HAL_StatusTypeDef HAL_ETH_Stop_IT(ETH_HandleTypeDef *heth)
{
	if (heth->gState != HAL_ETH_STATE_STARTED) {
		return HAL_ERROR;
	}
	heth->gState = 0;
	heth->Instance->MACCR &= ~ETH_MACCR_RE;
	heth->Instance->DMACRCR &= ~ETH_DMACRCR_SR;
	return HAL_OK;
}

struct eth_stm32_dma_buf {
	uint8_t tx_buf[ETH_TX_DESC_CNT][ETH_STM32_TX_BUF_SIZE];
};

struct eth_stm32_hal_dev_cfg {
	struct eth_stm32_dma_buf *dma_buf;
};

struct eth_stm32_hal_dev_data {
	ETH_HandleTypeDef heth;
	struct net_if *iface;
	uint8_t mac_addr[6];
	struct k_mutex ptp_lock;
	struct k_sem tx_int_sem;
	struct k_work_delayable ptp_tx_work;
	struct ethernet_ptp_config ptp_config;
	struct net_pkt *ptp_tx_pkt[ETH_TX_DESC_CNT];
	uint16_t ptp_tx_head, ptp_tx_tail, ptp_tx_used;
	atomic_t ptp_fault;
	bool ptp_stopping;
	int64_t ptp_tx_started[ETH_TX_DESC_CNT];
	bool ptp_tx_abandoned[ETH_TX_DESC_CNT];
};

static void test_dma_barrier(void);
struct net_pkt *eth_stm32_rx_locked(const struct device *dev);
bool eth_stm32_rx_pending(const struct device *dev);

#endif /* STM32_PTP_MOCK_HAL_H_ */
```
