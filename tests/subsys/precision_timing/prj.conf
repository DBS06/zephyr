## CMakeLists.txt
```
# SPDX-FileCopyrightText: Copyright The Zephyr Project Contributors
# SPDX-FileCopyrightText: Copyright (c) 2026 Philipp Steiner
#
# SPDX-License-Identifier: Apache-2.0

cmake_minimum_required(VERSION 3.20.0)
find_package(Zephyr REQUIRED HINTS $ENV{ZEPHYR_BASE})
project(precision_timing)

target_sources(app PRIVATE
  src/clock_sync.c
  src/main.c
)

target_include_directories(app PRIVATE
  ${ZEPHYR_BASE}/subsys/precision_timing
)
```

## prj.conf
```kconfig
# SPDX-FileCopyrightText: Copyright The Zephyr Project Contributors
# SPDX-FileCopyrightText: Copyright (c) 2026 Philipp Steiner
#
# SPDX-License-Identifier: Apache-2.0

CONFIG_ZTEST=y
CONFIG_PRECISION_TIMING=y
CONFIG_PRECISION_CLOCK_SYNC_SERVICE=y
CONFIG_PRECISION_SOFTWARE_CLOCK=y
CONFIG_PRECISION_REALTIME_BRIDGE=y
CONFIG_PTP_CLOCK=y
CONFIG_PTP_CLOCK_NATIVE=n
```

## src/clock_output.c
```c
/*
 * SPDX-FileCopyrightText: Copyright The Zephyr Project Contributors
 * SPDX-FileCopyrightText: Copyright (c) 2026 Philipp Steiner
 *
 * SPDX-License-Identifier: Apache-2.0
 */

#include <errno.h>

#include <zephyr/precision_timing/precision_clock.h>
#include <zephyr/ztest.h>

struct output_fake {
	struct precision_clock clock;
	struct precision_clock_output_caps caps;
	struct precision_clock_output_status status;
	precision_time_t now_ns;
	uint32_t last_channel;
	uint32_t waveform_calls;
	uint32_t stop_calls;
	bool provider_configured;
	int caps_error;
	int waveform_error;
	int stop_error;
	int status_error;
};

static int output_fake_read(const struct precision_clock *clock, precision_time_t *time)
{
	struct output_fake *fake = clock->data;

	*time = fake->now_ns;

	return 0;
}

static int output_fake_get_caps(const struct precision_clock *clock, uint32_t channel,
				struct precision_clock_output_caps *caps)
{
	struct output_fake *fake = clock->data;

	fake->last_channel = channel;
	if (fake->caps_error != 0) {
		return fake->caps_error;
	}

	*caps = fake->caps;

	return 0;
}

static void output_fake_mark_active(struct output_fake *fake)
{
	fake->provider_configured = true;
	fake->status.configured = true;
	fake->status.hardware_active_valid =
		(fake->caps.flags & PRECISION_CLOCK_OUTPUT_CAP_HARDWARE_ACTIVE) != 0U;
	fake->status.hardware_active = true;
}

static int output_fake_start_waveform(const struct precision_clock *clock, uint32_t channel,
				      const struct precision_clock_output_waveform_config *config)
{
	struct output_fake *fake = clock->data;

	fake->last_channel = channel;
	fake->waveform_calls++;
	if (fake->waveform_error != 0) {
		return fake->waveform_error;
	}
	if (fake->provider_configured) {
		return -EBUSY;
	}

	output_fake_mark_active(fake);
	fake->status.kind = PRECISION_CLOCK_OUTPUT_KIND_WAVEFORM;
	fake->status.config.waveform = *config;

	return 0;
}

static int output_fake_stop(const struct precision_clock *clock, uint32_t channel)
{
	struct output_fake *fake = clock->data;

	fake->last_channel = channel;
	if (channel >= fake->caps.channel_count) {
		return -ENOTSUP;
	}

	fake->stop_calls++;
	if (fake->stop_error != 0) {
		return fake->stop_error;
	}

	fake->provider_configured = false;
	fake->status.configured = false;

	return 0;
}

static int output_fake_get_status(const struct precision_clock *clock, uint32_t channel,
				  struct precision_clock_output_status *status)
{
	struct output_fake *fake = clock->data;

	fake->last_channel = channel;
	if (fake->status_error != 0) {
		return fake->status_error;
	}

	*status = fake->status;

	return 0;
}

static const struct precision_clock_api output_fake_api = {
	.read = output_fake_read,
	.get_output_caps = output_fake_get_caps,
	.output_start_waveform = output_fake_start_waveform,
	.output_stop = output_fake_stop,
	.get_output_status = output_fake_get_status,
};

static const struct precision_clock_api output_unsupported_api = {
	.read = output_fake_read,
};

static void output_fake_init(struct output_fake *fake)
{
	*fake = (struct output_fake){0};
	fake->clock = (struct precision_clock){
		.api = &output_fake_api,
		.data = fake,
	};
	fake->caps = (struct precision_clock_output_caps){
		.flags = PRECISION_CLOCK_OUTPUT_CAP_WAVEFORM |
			 PRECISION_CLOCK_OUTPUT_CAP_PROGRAMMABLE_WIDTH |
			 PRECISION_CLOCK_OUTPUT_CAP_HARDWARE_ACTIVE,
		.channel_count = 2,
		.resolution_ns = 10,
		.min_lead_time_ns = 100,
		.min_period_ns = 100,
		.max_period_ns = 10000,
		.min_pulse_width_ns = 20,
		.max_pulse_width_ns = 5000,
	};
	fake->now_ns = 1000;
}

static struct precision_clock_output_waveform_config valid_waveform_config(void)
{
	struct precision_clock_output_waveform_config config = {
		.period_ns = 1000,
		.width_policy = PRECISION_CLOCK_OUTPUT_WIDTH_EXACT,
		.pulse_width_ns = 100,
	};

	config.first_rising_time = 2000;

	return config;
}

ZTEST(precision_timing, test_clock_output_rejects_invalid_arguments)
{
	struct output_fake fake;
	struct precision_clock_output_caps caps;
	struct precision_clock_output_status status;
	struct precision_clock_output_waveform_config waveform = valid_waveform_config();
	struct precision_clock invalid_clock = {0};

	output_fake_init(&fake);
	zassert_equal(precision_clock_output_get_caps(NULL, 0, &caps), -EINVAL);
	zassert_equal(precision_clock_output_get_caps(&fake.clock, 0, NULL), -EINVAL);
	zassert_equal(precision_clock_output_get_caps(&invalid_clock, 0, &caps), -EINVAL);
	zassert_equal(precision_clock_output_start_waveform(NULL, 0, &waveform), -EINVAL);
	zassert_equal(precision_clock_output_start_waveform(&fake.clock, 0, NULL), -EINVAL);
	zassert_equal(precision_clock_output_stop(NULL, 0), -EINVAL);
	zassert_equal(precision_clock_output_get_status(NULL, 0, &status), -EINVAL);
	zassert_equal(precision_clock_output_get_status(&fake.clock, 0, NULL), -EINVAL);
}

ZTEST(precision_timing, test_clock_output_reports_unsupported_operations)
{
	struct output_fake fake;
	struct precision_clock_output_caps caps;
	struct precision_clock_output_status status;
	struct precision_clock_output_waveform_config waveform = valid_waveform_config();

	output_fake_init(&fake);
	fake.clock.api = &output_unsupported_api;
	zassert_equal(precision_clock_output_get_caps(&fake.clock, 0, &caps), -ENOTSUP);
	zassert_equal(precision_clock_output_start_waveform(&fake.clock, 0, &waveform), -ENOTSUP);
	zassert_equal(precision_clock_output_stop(&fake.clock, 0), -ENOTSUP);
	zassert_equal(precision_clock_output_get_status(&fake.clock, 0, &status), -ENOTSUP);
}

ZTEST(precision_timing, test_clock_output_calculates_next_aligned_start)
{
	precision_time_t start;
	precision_time_t now = 1999LL * NSEC_PER_MSEC;

	zassert_ok(
		precision_clock_output_next_start_time(now, NSEC_PER_SEC, NSEC_PER_MSEC, &start));
	zassert_equal(start, 2LL * NSEC_PER_SEC);

	now++;
	zassert_ok(
		precision_clock_output_next_start_time(now, NSEC_PER_SEC, NSEC_PER_MSEC, &start));
	zassert_equal(start, 3LL * NSEC_PER_SEC);

	now = -1500LL * NSEC_PER_MSEC;
	zassert_ok(precision_clock_output_next_start_time(now, NSEC_PER_SEC, 0, &start));
	zassert_equal(start, -(precision_time_t)NSEC_PER_SEC);
	now = -2LL * NSEC_PER_SEC;
	zassert_ok(precision_clock_output_next_start_time(now, NSEC_PER_SEC, 0, &start));
	zassert_equal(start, now);

	zassert_equal(precision_clock_output_next_start_time(now, 0, 0, &start), -EINVAL);
	zassert_equal(precision_clock_output_next_start_time(now, NSEC_PER_SEC, -1, &start),
		      -EINVAL);
	zassert_equal(precision_clock_output_next_start_time(now, NSEC_PER_SEC, 0, NULL), -EINVAL);

	now = PRECISION_TIME_MAX;
	zassert_equal(precision_clock_output_next_start_time(now, NSEC_PER_SEC, 1, &start),
		      -ERANGE);
	zassert_equal(precision_clock_output_next_start_time(now, NSEC_PER_SEC, 0, &start),
		      -ERANGE);
}

ZTEST(precision_timing, test_clock_output_queries_per_channel_capabilities)
{
	struct output_fake fake;
	struct precision_clock_output_caps caps;

	output_fake_init(&fake);
	zassert_ok(precision_clock_output_get_caps(&fake.clock, 1, &caps));
	zassert_equal(fake.last_channel, 1);
	zassert_equal(caps.channel_count, 2);
	zassert_equal(caps.resolution_ns, 10);
	zassert_equal(precision_clock_output_get_caps(&fake.clock, 2, &caps), -ENOTSUP);

	fake.caps_error = -EIO;
	zassert_equal(precision_clock_output_get_caps(&fake.clock, 0, &caps), -EIO);
}

ZTEST(precision_timing, test_clock_output_starts_waveform_exact_width)
{
	struct output_fake fake;
	struct precision_clock_output_status status;
	struct precision_clock_output_waveform_config waveform = valid_waveform_config();

	output_fake_init(&fake);
	zassert_ok(precision_clock_output_start_waveform(&fake.clock, 1, &waveform));
	zassert_equal(fake.waveform_calls, 1);
	zassert_equal(fake.last_channel, 1);
	zassert_equal(precision_clock_output_start_waveform(&fake.clock, 1, &waveform), -EBUSY);

	zassert_ok(precision_clock_output_get_status(&fake.clock, 1, &status));
	zassert_true(status.configured);
	zassert_equal(status.kind, PRECISION_CLOCK_OUTPUT_KIND_WAVEFORM);
	zassert_equal(status.config.waveform.first_rising_time, waveform.first_rising_time);
	zassert_equal(status.config.waveform.period_ns, waveform.period_ns);
	zassert_equal(status.config.waveform.width_policy, PRECISION_CLOCK_OUTPUT_WIDTH_EXACT);
	zassert_equal(status.config.waveform.pulse_width_ns, waveform.pulse_width_ns);
	zassert_true(status.hardware_active_valid);
	zassert_true(status.hardware_active);
}

ZTEST(precision_timing, test_clock_output_requires_waveform_capability)
{
	struct output_fake fake;
	struct precision_clock_output_waveform_config waveform = valid_waveform_config();

	output_fake_init(&fake);
	fake.caps.flags &= ~PRECISION_CLOCK_OUTPUT_CAP_WAVEFORM;
	zassert_equal(precision_clock_output_start_waveform(&fake.clock, 0, &waveform), -ENOTSUP);
	zassert_equal(fake.waveform_calls, 0);
}

ZTEST(precision_timing, test_clock_output_starts_waveform_provider_default_width)
{
	struct output_fake fake;
	struct precision_clock_output_waveform_config waveform = valid_waveform_config();

	output_fake_init(&fake);
	fake.caps.flags = PRECISION_CLOCK_OUTPUT_CAP_WAVEFORM;
	fake.caps.min_pulse_width_ns = 0;
	fake.caps.max_pulse_width_ns = 0;
	waveform.width_policy = PRECISION_CLOCK_OUTPUT_WIDTH_PROVIDER_DEFAULT;
	waveform.pulse_width_ns = 0;
	zassert_ok(precision_clock_output_start_waveform(&fake.clock, 0, &waveform));
	zassert_equal(fake.waveform_calls, 1);
	zassert_ok(precision_clock_output_stop(&fake.clock, 0));

	waveform = valid_waveform_config();
	zassert_equal(precision_clock_output_start_waveform(&fake.clock, 0, &waveform), -ENOTSUP);
	zassert_equal(fake.waveform_calls, 1);
}

ZTEST(precision_timing, test_clock_output_rejects_invalid_waveform_arguments)
{
	struct output_fake fake;
	struct precision_clock_output_waveform_config waveform = valid_waveform_config();

	output_fake_init(&fake);
	waveform.width_policy = (enum precision_clock_output_width_policy)5;
	zassert_equal(precision_clock_output_start_waveform(&fake.clock, 0, &waveform), -EINVAL);
	waveform = valid_waveform_config();
	waveform.period_ns = 0;
	zassert_equal(precision_clock_output_start_waveform(&fake.clock, 0, &waveform), -EINVAL);
	waveform = valid_waveform_config();
	waveform.pulse_width_ns = 0;
	zassert_equal(precision_clock_output_start_waveform(&fake.clock, 0, &waveform), -EINVAL);
	waveform = valid_waveform_config();
	waveform.pulse_width_ns = waveform.period_ns;
	zassert_equal(precision_clock_output_start_waveform(&fake.clock, 0, &waveform), -EINVAL);
	zassert_equal(fake.waveform_calls, 0);
}

ZTEST(precision_timing, test_clock_output_validates_waveform_limits_and_resolution)
{
	struct output_fake fake;
	struct precision_clock_output_waveform_config waveform = valid_waveform_config();

	output_fake_init(&fake);
	waveform.period_ns = fake.caps.min_period_ns - fake.caps.resolution_ns;
	waveform.pulse_width_ns = fake.caps.min_pulse_width_ns;
	zassert_equal(precision_clock_output_start_waveform(&fake.clock, 0, &waveform), -ERANGE);
	waveform = valid_waveform_config();
	waveform.period_ns = fake.caps.max_period_ns + fake.caps.resolution_ns;
	zassert_equal(precision_clock_output_start_waveform(&fake.clock, 0, &waveform), -ERANGE);
	waveform = valid_waveform_config();
	waveform.pulse_width_ns = fake.caps.min_pulse_width_ns - fake.caps.resolution_ns;
	zassert_equal(precision_clock_output_start_waveform(&fake.clock, 0, &waveform), -ERANGE);
	waveform = valid_waveform_config();
	waveform.period_ns = 6000;
	waveform.pulse_width_ns = fake.caps.max_pulse_width_ns + fake.caps.resolution_ns;
	zassert_equal(precision_clock_output_start_waveform(&fake.clock, 0, &waveform), -ERANGE);

	waveform = valid_waveform_config();
	waveform.first_rising_time++;
	zassert_equal(precision_clock_output_start_waveform(&fake.clock, 0, &waveform), -ERANGE);
	waveform = valid_waveform_config();
	waveform.period_ns++;
	zassert_equal(precision_clock_output_start_waveform(&fake.clock, 0, &waveform), -ERANGE);
	waveform = valid_waveform_config();
	waveform.pulse_width_ns++;
	zassert_equal(precision_clock_output_start_waveform(&fake.clock, 0, &waveform), -ERANGE);
	zassert_equal(fake.waveform_calls, 0);
}

ZTEST(precision_timing, test_clock_output_rejects_malformed_provider_caps)
{
	struct output_fake fake;
	struct precision_clock_output_waveform_config waveform = valid_waveform_config();

	output_fake_init(&fake);
	fake.caps.resolution_ns = 0;
	zassert_equal(precision_clock_output_start_waveform(&fake.clock, 0, &waveform), -ERANGE);
	fake.caps.resolution_ns = 10;
	fake.caps.min_lead_time_ns = -1;
	zassert_equal(precision_clock_output_start_waveform(&fake.clock, 0, &waveform), -ERANGE);
	fake.caps.min_lead_time_ns = 100;
	fake.caps.max_period_ns = fake.caps.min_period_ns - 1;
	zassert_equal(precision_clock_output_start_waveform(&fake.clock, 0, &waveform), -ERANGE);
	fake.caps.max_period_ns = 10000;
	fake.caps.max_pulse_width_ns = fake.caps.min_pulse_width_ns - 1;
	zassert_equal(precision_clock_output_start_waveform(&fake.clock, 0, &waveform), -ERANGE);
}

ZTEST(precision_timing, test_clock_output_enforces_minimum_lead_time)
{
	struct output_fake fake;
	struct precision_clock_output_waveform_config waveform = valid_waveform_config();

	output_fake_init(&fake);
	waveform.first_rising_time = fake.now_ns - fake.caps.resolution_ns;
	zassert_equal(precision_clock_output_start_waveform(&fake.clock, 0, &waveform), -ETIME);
	waveform.first_rising_time =
		fake.now_ns + fake.caps.min_lead_time_ns - fake.caps.resolution_ns;
	zassert_equal(precision_clock_output_start_waveform(&fake.clock, 0, &waveform), -ETIME);
	waveform.first_rising_time = fake.now_ns + fake.caps.min_lead_time_ns;
	zassert_ok(precision_clock_output_start_waveform(&fake.clock, 0, &waveform));

	output_fake_init(&fake);
	fake.now_ns = PRECISION_TIME_MAX - 57;
	waveform = valid_waveform_config();
	waveform.first_rising_time = PRECISION_TIME_MAX - 7;
	zassert_equal(precision_clock_output_start_waveform(&fake.clock, 0, &waveform), -ERANGE);
}

ZTEST(precision_timing, test_clock_output_validates_status_consistency)
{
	struct output_fake fake;
	struct precision_clock_output_status status;

	output_fake_init(&fake);
	fake.caps.flags = 0;
	fake.status.configured = true;
	fake.status.kind = PRECISION_CLOCK_OUTPUT_KIND_WAVEFORM;
	fake.status.config.waveform = valid_waveform_config();
	zassert_equal(precision_clock_output_get_status(&fake.clock, 0, &status), -EINVAL);

	output_fake_init(&fake);
	fake.caps.flags = PRECISION_CLOCK_OUTPUT_CAP_WAVEFORM;
	fake.status.configured = false;
	fake.status.hardware_active_valid = true;
	zassert_equal(precision_clock_output_get_status(&fake.clock, 0, &status), -EINVAL);

	output_fake_init(&fake);
	fake.status.configured = true;
	fake.status.kind = (enum precision_clock_output_kind)7;
	zassert_equal(precision_clock_output_get_status(&fake.clock, 0, &status), -EINVAL);

	output_fake_init(&fake);
	fake.status.configured = false;
	fake.status.hardware_active_valid = true;
	fake.status.hardware_active = false;
	zassert_ok(precision_clock_output_get_status(&fake.clock, 0, &status));
	zassert_false(status.configured);
	zassert_true(status.hardware_active_valid);
	zassert_false(status.hardware_active);
}

ZTEST(precision_timing, test_clock_output_validates_waveform_status_configuration)
{
	struct precision_clock_output_waveform_config waveform = valid_waveform_config();
	struct precision_clock_output_status status;
	struct output_fake fake;

	output_fake_init(&fake);
	fake.now_ns = waveform.first_rising_time + NSEC_PER_SEC;
	fake.status.configured = true;
	fake.status.kind = PRECISION_CLOCK_OUTPUT_KIND_WAVEFORM;
	fake.status.config.waveform = waveform;
	zassert_ok(precision_clock_output_get_status(&fake.clock, 0, &status));

	fake.status.config.waveform.period_ns = 0;
	zassert_equal(precision_clock_output_get_status(&fake.clock, 0, &status), -EINVAL);

	fake.status.config.waveform = waveform;
	fake.status.config.waveform.period_ns++;
	zassert_equal(precision_clock_output_get_status(&fake.clock, 0, &status), -EINVAL);

	fake.status.config.waveform = waveform;
	fake.status.config.waveform.period_ns = fake.caps.min_period_ns - fake.caps.resolution_ns;
	fake.status.config.waveform.pulse_width_ns = fake.caps.min_pulse_width_ns;
	zassert_equal(precision_clock_output_get_status(&fake.clock, 0, &status), -EINVAL);

	fake.status.config.waveform = waveform;
	fake.status.config.waveform.period_ns = fake.caps.max_period_ns + fake.caps.resolution_ns;
	zassert_equal(precision_clock_output_get_status(&fake.clock, 0, &status), -EINVAL);

	fake.status.config.waveform = waveform;
	fake.status.config.waveform.width_policy = (enum precision_clock_output_width_policy)7;
	zassert_equal(precision_clock_output_get_status(&fake.clock, 0, &status), -EINVAL);

	fake.status.config.waveform = waveform;
	fake.caps.flags &= ~PRECISION_CLOCK_OUTPUT_CAP_PROGRAMMABLE_WIDTH;
	zassert_equal(precision_clock_output_get_status(&fake.clock, 0, &status), -EINVAL);

	fake.caps.flags |= PRECISION_CLOCK_OUTPUT_CAP_PROGRAMMABLE_WIDTH;
	fake.status.config.waveform.pulse_width_ns = waveform.period_ns;
	zassert_equal(precision_clock_output_get_status(&fake.clock, 0, &status), -EINVAL);

	fake.status.config.waveform = waveform;
	fake.status.config.waveform.pulse_width_ns =
		fake.caps.min_pulse_width_ns - fake.caps.resolution_ns;
	zassert_equal(precision_clock_output_get_status(&fake.clock, 0, &status), -EINVAL);

	fake.status.config.waveform = waveform;
	fake.status.config.waveform.period_ns = 6000;
	fake.status.config.waveform.pulse_width_ns =
		fake.caps.max_pulse_width_ns + fake.caps.resolution_ns;
	zassert_equal(precision_clock_output_get_status(&fake.clock, 0, &status), -EINVAL);

	fake.status.config.waveform = waveform;
	fake.status.config.waveform.pulse_width_ns++;
	zassert_equal(precision_clock_output_get_status(&fake.clock, 0, &status), -EINVAL);

	fake.status.config.waveform = waveform;
	fake.status.config.waveform.first_rising_time++;
	zassert_equal(precision_clock_output_get_status(&fake.clock, 0, &status), -EINVAL);

	fake.caps.flags = PRECISION_CLOCK_OUTPUT_CAP_WAVEFORM;
	fake.caps.min_pulse_width_ns = 0;
	fake.caps.max_pulse_width_ns = 0;
	fake.status.config.waveform = waveform;
	fake.status.config.waveform.width_policy = PRECISION_CLOCK_OUTPUT_WIDTH_PROVIDER_DEFAULT;
	fake.status.config.waveform.pulse_width_ns = 0;
	zassert_ok(precision_clock_output_get_status(&fake.clock, 0, &status));
}

ZTEST(precision_timing, test_clock_output_stop_and_propagates_errors)
{
	struct output_fake fake;
	struct precision_clock_output_status status;
	struct precision_clock_output_waveform_config waveform = valid_waveform_config();

	output_fake_init(&fake);
	zassert_ok(precision_clock_output_stop(&fake.clock, 0));
	zassert_equal(fake.stop_calls, 1);
	zassert_equal(precision_clock_output_stop(&fake.clock, 2), -ENOTSUP);
	zassert_equal(precision_clock_output_get_status(&fake.clock, 2, &status), -ENOTSUP);

	fake.waveform_error = -EIO;
	zassert_equal(precision_clock_output_start_waveform(&fake.clock, 0, &waveform), -EIO);
	fake.stop_error = -EBUSY;
	zassert_equal(precision_clock_output_stop(&fake.clock, 0), -EBUSY);
	fake.status_error = -EAGAIN;
	zassert_equal(precision_clock_output_get_status(&fake.clock, 0, &status), -EAGAIN);
}
```

## src/ptp_clock_output.c
```c
/*
 * SPDX-FileCopyrightText: Copyright The Zephyr Project Contributors
 * SPDX-FileCopyrightText: Copyright (c) 2026 Philipp Steiner
 *
 * SPDX-License-Identifier: Apache-2.0
 */

#include <errno.h>

#include <zephyr/device.h>
#include <zephyr/drivers/precision_clock_output.h>
#include <zephyr/drivers/ptp_clock.h>
#include <zephyr/precision_timing/precision_clock.h>
#include <zephyr/precision_timing/precision_clock_ptp.h>
#include <zephyr/ztest.h>

struct ptp_output_fake {
	struct precision_clock_output_caps caps;
	struct precision_clock_output_raw_status status;
	struct precision_clock_output_raw_waveform_config waveform_config;
	struct net_ptp_time now;
	uint32_t last_channel;
	uint32_t waveform_calls;
	uint32_t stop_calls;
	int caps_error;
	int waveform_error;
	int stop_error;
	int status_error;
};

static struct ptp_output_fake ptp_output_fake;

static void ptp_output_fake_mark_active(void)
{
	ptp_output_fake.status.configured = true;
	ptp_output_fake.status.hardware_active_valid =
		(ptp_output_fake.caps.flags & PRECISION_CLOCK_OUTPUT_CAP_HARDWARE_ACTIVE) != 0U;
	ptp_output_fake.status.hardware_active = true;
}

static int ptp_output_fake_get(const struct device *dev, struct net_ptp_time *tm)
{
	ARG_UNUSED(dev);

	*tm = ptp_output_fake.now;

	return 0;
}

static int ptp_output_fake_get_caps(const struct device *dev, uint32_t channel,
				    struct precision_clock_output_caps *caps)
{
	ARG_UNUSED(dev);

	ptp_output_fake.last_channel = channel;
	if (ptp_output_fake.caps_error != 0) {
		return ptp_output_fake.caps_error;
	}

	*caps = ptp_output_fake.caps;

	return 0;
}

static int
ptp_output_fake_start_waveform(const struct device *dev, uint32_t channel,
			       const struct precision_clock_output_raw_waveform_config *cfg)
{
	ARG_UNUSED(dev);

	ptp_output_fake.last_channel = channel;
	ptp_output_fake.waveform_calls++;
	if (ptp_output_fake.waveform_error != 0) {
		return ptp_output_fake.waveform_error;
	}

	ptp_output_fake.waveform_config = *cfg;
	ptp_output_fake_mark_active();
	ptp_output_fake.status.kind = PRECISION_CLOCK_OUTPUT_KIND_WAVEFORM;
	ptp_output_fake.status.config.waveform = *cfg;

	return 0;
}

static int ptp_output_fake_stop(const struct device *dev, uint32_t channel)
{
	ARG_UNUSED(dev);

	ptp_output_fake.last_channel = channel;
	ptp_output_fake.stop_calls++;
	if (ptp_output_fake.stop_error != 0) {
		return ptp_output_fake.stop_error;
	}

	ptp_output_fake.status.configured = false;

	return 0;
}

static int ptp_output_fake_get_status(const struct device *dev, uint32_t channel,
				      struct precision_clock_output_raw_status *status)
{
	ARG_UNUSED(dev);

	ptp_output_fake.last_channel = channel;
	if (ptp_output_fake.status_error != 0) {
		return ptp_output_fake.status_error;
	}

	*status = ptp_output_fake.status;

	return 0;
}

static const struct precision_clock_output_provider ptp_output_full_provider = {
	.get_caps = ptp_output_fake_get_caps,
	.start_waveform = ptp_output_fake_start_waveform,
	.stop = ptp_output_fake_stop,
	.get_status = ptp_output_fake_get_status,
};

static const struct precision_clock_output_provider ptp_output_missing_waveform_provider = {
	.get_caps = ptp_output_fake_get_caps,
	.stop = ptp_output_fake_stop,
	.get_status = ptp_output_fake_get_status,
};

static const struct precision_clock_output_provider ptp_output_missing_caps_provider = {
	.start_waveform = ptp_output_fake_start_waveform,
	.stop = ptp_output_fake_stop,
	.get_status = ptp_output_fake_get_status,
};

static const struct precision_clock_output_provider ptp_output_missing_stop_provider = {
	.get_caps = ptp_output_fake_get_caps,
	.start_waveform = ptp_output_fake_start_waveform,
	.get_status = ptp_output_fake_get_status,
};

static const struct precision_clock_output_provider ptp_output_missing_status_provider = {
	.get_caps = ptp_output_fake_get_caps,
	.start_waveform = ptp_output_fake_start_waveform,
	.stop = ptp_output_fake_stop,
};

static DEVICE_API(ptp_clock, ptp_output_full_api) = {
	.get = ptp_output_fake_get,
	.output = &ptp_output_full_provider,
};

DEVICE_DEFINE(ptp_output_full, "ptp_output_full", NULL, NULL, NULL, NULL, POST_KERNEL,
	      CONFIG_KERNEL_INIT_PRIORITY_DEVICE, &ptp_output_full_api);

static DEVICE_API(ptp_clock, ptp_output_no_extension_api) = {
	.get = ptp_output_fake_get,
};

DEVICE_DEFINE(ptp_output_no_extension, "ptp_output_no_extension", NULL, NULL, NULL, NULL,
	      POST_KERNEL, CONFIG_KERNEL_INIT_PRIORITY_DEVICE, &ptp_output_no_extension_api);

static DEVICE_API(ptp_clock, ptp_output_missing_waveform_api) = {
	.get = ptp_output_fake_get,
	.output = &ptp_output_missing_waveform_provider,
};

DEVICE_DEFINE(ptp_output_missing_waveform, "ptp_output_missing_waveform", NULL, NULL, NULL, NULL,
	      POST_KERNEL, CONFIG_KERNEL_INIT_PRIORITY_DEVICE, &ptp_output_missing_waveform_api);

static DEVICE_API(ptp_clock, ptp_output_missing_caps_api) = {
	.get = ptp_output_fake_get,
	.output = &ptp_output_missing_caps_provider,
};

DEVICE_DEFINE(ptp_output_missing_caps, "ptp_output_missing_caps", NULL, NULL, NULL, NULL,
	      POST_KERNEL, CONFIG_KERNEL_INIT_PRIORITY_DEVICE, &ptp_output_missing_caps_api);

static DEVICE_API(ptp_clock, ptp_output_missing_stop_api) = {
	.get = ptp_output_fake_get,
	.output = &ptp_output_missing_stop_provider,
};

DEVICE_DEFINE(ptp_output_missing_stop, "ptp_output_missing_stop", NULL, NULL, NULL, NULL,
	      POST_KERNEL, CONFIG_KERNEL_INIT_PRIORITY_DEVICE, &ptp_output_missing_stop_api);

static DEVICE_API(ptp_clock, ptp_output_missing_status_api) = {
	.get = ptp_output_fake_get,
	.output = &ptp_output_missing_status_provider,
};

DEVICE_DEFINE(ptp_output_missing_status, "ptp_output_missing_status", NULL, NULL, NULL, NULL,
	      POST_KERNEL, CONFIG_KERNEL_INIT_PRIORITY_DEVICE, &ptp_output_missing_status_api);

static void ptp_output_fake_init(void)
{
	ptp_output_fake = (struct ptp_output_fake){0};
	ptp_output_fake.caps = (struct precision_clock_output_caps){
		.flags = PRECISION_CLOCK_OUTPUT_CAP_WAVEFORM |
			 PRECISION_CLOCK_OUTPUT_CAP_PROGRAMMABLE_WIDTH |
			 PRECISION_CLOCK_OUTPUT_CAP_HARDWARE_ACTIVE,
		.channel_count = 2,
		.resolution_ns = 10,
		.min_lead_time_ns = 100,
		.min_period_ns = 100,
		.max_period_ns = 2000000000LL,
		.min_pulse_width_ns = 20,
		.max_pulse_width_ns = 1000000000LL,
	};
	ptp_output_fake.now = (struct net_ptp_time){
		.second = 1,
		.nanosecond = 20,
	};
}

static struct precision_clock_output_waveform_config valid_waveform_config(void)
{
	struct precision_clock_output_waveform_config config = {
		.period_ns = NSEC_PER_SEC,
		.width_policy = PRECISION_CLOCK_OUTPUT_WIDTH_EXACT,
		.pulse_width_ns = 100 * NSEC_PER_MSEC,
	};

	config.first_rising_time = 3LL * NSEC_PER_SEC + 40;

	return config;
}

ZTEST(precision_timing, test_ptp_clock_output_discovers_and_converts)
{
	struct precision_clock_ptp_adapter adapter;
	struct precision_clock_output_caps caps;
	struct precision_clock_output_status status;
	struct precision_clock_output_waveform_config waveform = valid_waveform_config();
	const struct precision_clock *clock;

	ptp_output_fake_init();
	precision_clock_ptp_init(&adapter, DEVICE_GET(ptp_output_full));
	clock = precision_clock_ptp_get(&adapter);

	zassert_ok(precision_clock_output_get_caps(clock, 1, &caps));
	zassert_equal(ptp_output_fake.last_channel, 1);
	zassert_equal(caps.flags, ptp_output_fake.caps.flags);
	zassert_equal(caps.channel_count, ptp_output_fake.caps.channel_count);
	zassert_equal(caps.resolution_ns, ptp_output_fake.caps.resolution_ns);
	zassert_equal(caps.min_lead_time_ns, ptp_output_fake.caps.min_lead_time_ns);
	zassert_equal(caps.max_period_ns, ptp_output_fake.caps.max_period_ns);

	zassert_ok(precision_clock_output_start_waveform(clock, 0, &waveform));
	zassert_equal(ptp_output_fake.waveform_calls, 1);
	zassert_equal(ptp_output_fake.waveform_config.first_rising_time, 3LL * NSEC_PER_SEC + 40);
	zassert_equal(ptp_output_fake.waveform_config.period_ns, NSEC_PER_SEC);
	zassert_equal(ptp_output_fake.waveform_config.width_policy,
		      PRECISION_CLOCK_OUTPUT_WIDTH_EXACT);
	zassert_equal(ptp_output_fake.waveform_config.pulse_width_ns, 100 * NSEC_PER_MSEC);

	zassert_ok(precision_clock_output_get_status(clock, 0, &status));
	zassert_true(status.configured);
	zassert_true(status.hardware_active_valid);
	zassert_true(status.hardware_active);
	zassert_equal(status.kind, PRECISION_CLOCK_OUTPUT_KIND_WAVEFORM);
	zassert_equal(status.config.waveform.first_rising_time, 3LL * NSEC_PER_SEC + 40);
	zassert_equal(status.config.waveform.period_ns, NSEC_PER_SEC);
	zassert_equal(status.config.waveform.pulse_width_ns, 100 * NSEC_PER_MSEC);
	zassert_ok(precision_clock_output_stop(clock, 0));
	zassert_equal(ptp_output_fake.stop_calls, 1);
	zassert_ok(precision_clock_output_get_status(clock, 0, &status));
	zassert_false(status.configured);
}

ZTEST(precision_timing, test_ptp_clock_output_propagates_errors)
{
	struct precision_clock_ptp_adapter adapter;
	struct precision_clock_output_caps caps;
	struct precision_clock_output_status status;
	struct precision_clock_output_waveform_config waveform = valid_waveform_config();
	const struct precision_clock *clock;

	ptp_output_fake_init();
	precision_clock_ptp_init(&adapter, DEVICE_GET(ptp_output_full));
	clock = precision_clock_ptp_get(&adapter);

	ptp_output_fake.caps_error = -EIO;
	zassert_equal(precision_clock_output_get_caps(clock, 0, &caps), -EIO);
	ptp_output_fake.caps_error = 0;

	ptp_output_fake.waveform_error = -ENOSPC;
	zassert_equal(precision_clock_output_start_waveform(clock, 0, &waveform), -ENOSPC);
	ptp_output_fake.waveform_error = 0;

	ptp_output_fake.stop_error = -EIO;
	zassert_equal(precision_clock_output_stop(clock, 0), -EIO);
	ptp_output_fake.stop_error = 0;

	ptp_output_fake.status_error = -EAGAIN;
	zassert_equal(precision_clock_output_get_status(clock, 0, &status), -EAGAIN);
}

ZTEST(precision_timing, test_ptp_clock_output_requires_usable_channel)
{
	struct precision_clock_ptp_adapter adapter;
	struct precision_clock_output_caps output_caps;
	const struct precision_clock *clock;

	ptp_output_fake_init();
	ptp_output_fake.caps.channel_count = 0U;
	precision_clock_ptp_init(&adapter, DEVICE_GET(ptp_output_full));
	clock = precision_clock_ptp_get(&adapter);
	zassert_equal(precision_clock_output_get_caps(clock, 0, &output_caps), -ENOTSUP);

	ptp_output_fake_init();
	ptp_output_fake.caps_error = -EIO;
	precision_clock_ptp_init(&adapter, DEVICE_GET(ptp_output_full));
	clock = precision_clock_ptp_get(&adapter);
	zassert_equal(precision_clock_output_get_caps(clock, 0, &output_caps), -EIO);
}

static void assert_no_scheduled_output(const struct device *dev)
{
	struct precision_clock_ptp_adapter adapter;
	struct precision_clock_output_caps output_caps;
	struct precision_clock_output_status status;
	struct precision_clock_output_waveform_config waveform = valid_waveform_config();
	const struct precision_clock *clock;

	precision_clock_ptp_init(&adapter, dev);
	clock = precision_clock_ptp_get(&adapter);
	zassert_equal(precision_clock_output_get_caps(clock, 0, &output_caps), -ENOTSUP);
	zassert_equal(precision_clock_output_start_waveform(clock, 0, &waveform), -ENOTSUP);
	zassert_equal(precision_clock_output_stop(clock, 0), -ENOTSUP);
	zassert_equal(precision_clock_output_get_status(clock, 0, &status), -ENOTSUP);
}

ZTEST(precision_timing, test_ptp_clock_output_requires_common_callbacks)
{
	struct precision_clock_ptp_adapter adapter;
	struct precision_clock_output_caps caps;
	struct precision_clock_output_status status;
	struct precision_clock_output_waveform_config waveform = valid_waveform_config();
	const struct precision_clock *clock;

	ptp_output_fake_init();
	assert_no_scheduled_output(DEVICE_GET(ptp_output_no_extension));

	precision_clock_ptp_init(&adapter, DEVICE_GET(ptp_output_missing_waveform));
	clock = precision_clock_ptp_get(&adapter);
	zassert_ok(precision_clock_output_get_caps(clock, 0, &caps));
	zassert_equal(precision_clock_output_start_waveform(clock, 0, &waveform), -ENOTSUP);
	zassert_ok(precision_clock_output_stop(clock, 0));
	zassert_ok(precision_clock_output_get_status(clock, 0, &status));

	precision_clock_ptp_init(&adapter, DEVICE_GET(ptp_output_missing_caps));
	clock = precision_clock_ptp_get(&adapter);
	zassert_equal(precision_clock_output_get_caps(clock, 0, &caps), -ENOTSUP);
	zassert_equal(precision_clock_output_start_waveform(clock, 0, &waveform), -ENOTSUP);
	zassert_ok(precision_clock_output_stop(clock, 0));
	zassert_equal(precision_clock_output_get_status(clock, 0, &status), -ENOTSUP);

	precision_clock_ptp_init(&adapter, DEVICE_GET(ptp_output_missing_stop));
	clock = precision_clock_ptp_get(&adapter);
	zassert_equal(precision_clock_output_stop(clock, 0), -ENOTSUP);

	precision_clock_ptp_init(&adapter, DEVICE_GET(ptp_output_missing_status));
	clock = precision_clock_ptp_get(&adapter);
	zassert_equal(precision_clock_output_get_status(clock, 0, &status), -ENOTSUP);
}
```
