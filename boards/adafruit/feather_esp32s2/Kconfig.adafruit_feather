## boards/adafruit/feather_esp32s2/Kconfig.adafruit_feather
```kconfig
# SPDX-License-Identifier: Apache-2.0

config BOARD_ADAFRUIT_FEATHER
	select SOC_ESP32S2_R2
```

## boards/adafruit/feather_esp32s2/board.yml
```yaml
board:
  name: adafruit_feather_esp32s2
  full_name: Adafruit Feather ESP32S2
  vendor: adafruit
  socs:
    - name: esp32s2
      variants:
        - name: 'revb'
        - name: 'revc'
          variants:
            - name: 'max17048'
        - name: 'tft'
          variants:
            - name: 'max17048'
            - name: 'reverse'
```

## drivers/fuel_gauge/lc709203f/Kconfig
```kconfig
# Copyright (c) 2023, ithinx GmbH
# Copyright (c) 2023, Tonies GmbH
#
# SPDX-License-Identifier: Apache-2.0

config LC709203F
	bool "LC709203F Fuel Gauge"
	default y
	depends on DT_HAS_ONSEMI_LC709203F_ENABLED
	select I2C
	help
	  Enable I2C-based driver for LC709203F Fuel Gauge.

# config EMUL_BQ27Z746
# 	bool "Emulate an BQ27Z746 fuel gague"
# 	default y
# 	depends on EMUL
# 	depends on BQ27Z746
# 	help
# 	  It provides readings which follow a simple sequence, thus allowing
# 	  test code to check that things are working as expected.
```

## dts/bindings/fuel-gauge/onsemi,lc709203f.yaml
```yaml
# Copyright (c) 2025 Philipp Steiner <philipp.steiner1987@gmail.com>
# SPDX-License-Identifier: Apache-2.0

description: |
  ON Semiconductor LC709203F fuel gauge. For more info visit
  https://www.onsemi.com/products/power-management/battery-management/battery-fuel-gauges/LC709204F

compatible: "onsemi,lc709203f"

include: [i2c-device.yaml, fuel-gauge.yaml]

# properties:
#   apa:
#     type: string
#     required: true
#     description: adjustment value for a battery type to improve the RSOC precision.
#       Typical values are provided and should be selected approximately.
#     enum:
#       - "apa-100mah"
#       - "apa-200mah"
#       - "apa-500mah"
#       - "apa-1000mah"
#       - "apa-2000mah"
#       - "apa-3000mah"
```

## tests/drivers/ethernet/native_tap_ptp_clock/testcase.yaml
```yaml
common:
  tags:
    - drivers
    - ethernet
    - ptp
tests:
  net.ethernet.native_tap_ptp_clock:
    platform_allow:
      - native_sim
      - native_sim/native/64
    integration_platforms:
      - native_sim/native/64
```

## tests/subsys/precision_timing/testcase.yaml
```yaml
common:
  tags:
    - timing
    - precision_timing
    - unit
  platform_allow:
    - native_sim
    - native_sim/native/64
  integration_platforms:
    - native_sim/native/64
tests:
  subsys.precision_timing: {}
```
