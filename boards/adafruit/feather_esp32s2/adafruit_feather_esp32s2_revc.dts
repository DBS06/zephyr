/*
 * Copyright (c) 2025 Philipp Steiner <philipp.steiner@gmail.com>
 *
 * SPDX-License-Identifier: Apache-2.0
 */

/dts-v1/;

#include "adafruit_feather_esp32s2_common.dtsi"
#include "feather_connector.dtsi"

/ {
	model = "Adafruit Feather ESP32-S2 Rev C";
	compatible = "adafruit,feather-esp32s2-revc";

	/*
	 * On-board regulator powers I2C pull-ups and external devices connected
	 * via the STEMMA QT connector.
	 */
	i2c_reg: i2c_reg {
		label = "I2C Power";
		compatible = "power-domain-gpio";
		#power-domain-cells = <0>;
		enable-gpios = <&gpio0 7 GPIO_ACTIVE_HIGH>;
	};
};
