## prj.conf
```kconfig
CONFIG_NETWORKING=y
CONFIG_NET_LOG=y
CONFIG_LOG=y
CONFIG_NET_IPV4=y
CONFIG_NET_DHCPV4=n
CONFIG_NET_UDP=y

CONFIG_TEST_RANDOM_GENERATOR=y

CONFIG_NET_PKT_RX_COUNT=32
CONFIG_NET_PKT_TX_COUNT=32
CONFIG_NET_BUF_RX_COUNT=32
CONFIG_NET_BUF_TX_COUNT=32
CONFIG_NET_MAX_CONTEXTS=10

CONFIG_INIT_STACKS=y
CONFIG_PRINTK=y
CONFIG_NET_SHELL=y
CONFIG_LOG_MODE_DEFERRED=y

# Ethernet is needed for PTP
CONFIG_NET_L2_ETHERNET=y
CONFIG_NET_PKT_FILTER=y

CONFIG_NET_CONFIG_NEED_IPV4=y
CONFIG_NET_CONFIG_SETTINGS=y

# First ethernet interface will use these settings
CONFIG_NET_CONFIG_MY_IPV4_ADDR="192.0.2.1"
CONFIG_NET_CONFIG_PEER_IPV4_ADDR="192.0.2.2"

# PTP settings
CONFIG_PTP_CLOCK=y
CONFIG_PTP=y
CONFIG_PTP_ANNOUNCE_RECV_TIMEOUT=5
CONFIG_PTP_LOG_LEVEL_DBG=y
CONFIG_PTP_DSCP_HIGH_PRIORITY=y

# PTP sample settings
CONFIG_NET_SHELL_PTP_SUPPORTED=y
CONFIG_PTP_CLOCK_SHELL=y
CONFIG_NET_SAMPLE_RUN_DURATION=0
```

## overlay-pps-output.conf
```kconfig
# SPDX-FileCopyrightText: Copyright The Zephyr Project Contributors
# SPDX-License-Identifier: Apache-2.0

CONFIG_PRECISION_TIMING=y
CONFIG_PRECISION_CLOCK_OUTPUT=y
CONFIG_PRECISION_TIMING_SHELL=y
CONFIG_SHELL=y
CONFIG_SHELL_BACKEND_SERIAL=y
CONFIG_PTP_CLOCK_STM32_HAL_OUTPUT=y
CONFIG_ETH_STM32_HAL_PTP_CLOCK_SRC_HZ=100000000
CONFIG_PTP_TIME_RECEIVER_ONLY=y
CONFIG_PTP_IEEE_802_3_PROTOCOL=y
CONFIG_PTP_DELAY_MECHANISM_P2P=y
CONFIG_PTP_NETWORK_MODE_MULTICAST=y
CONFIG_PTP_NETWORK_MODE_HYBRID=n
CONFIG_MAIN_STACK_SIZE=4096
CONFIG_NET_SAMPLE_RUN_DURATION=0
```

## boards/native_sim.conf
```kconfig
# Settings for native_sim / native_tap ethernet driver
CONFIG_ETH_NATIVE_TAP_PTP_CLOCK=y
CONFIG_ETH_NATIVE_TAP_PTP_CLOCK_EMULATED=y

CONFIG_ETH_NATIVE_TAP_RANDOM_MAC=n
CONFIG_ETH_NATIVE_TAP_MAC_ADDR="00:00:5e:00:53:2a"

# Assume 1 ms accuracy for native_sim simulated clock
CONFIG_PTP_CLOCK_ACCURACY_1MS=y
```

## src/main.c
```c
/*
 * Copyright (c) 2024 BayLibre SAS
 * Copyright (c) 2026 Philipp Steiner
 *
 * SPDX-License-Identifier: Apache-2.0
 */

#include <zephyr/logging/log.h>
LOG_MODULE_REGISTER(net_ptp_sample, LOG_LEVEL_DBG);

#include <zephyr/device.h>
#include <zephyr/net/ethernet.h>
#include <zephyr/net/net_if.h>
#include <zephyr/precision_timing/precision_clock_ptp.h>
#include <zephyr/precision_timing/precision_timing_shell.h>

#include <zephyr/kernel.h>

#include <errno.h>
#include <stdlib.h>

#include "ptp/clock.h"
#include "ptp/port.h"

static int run_duration = CONFIG_NET_SAMPLE_RUN_DURATION;
static struct k_work_delayable stop_sample;
static struct k_sem quit_lock;

static void stop_handler(struct k_work *work)
{
	ARG_UNUSED(work);

	k_sem_give(&quit_lock);
}

static int get_current_status(void)
{
	struct ptp_port *port;
	sys_slist_t *ports_list = ptp_clock_ports_list();

	if (!ports_list || sys_slist_len(ports_list) == 0) {
		return -EINVAL;
	}

	port = CONTAINER_OF(sys_slist_peek_head(ports_list), struct ptp_port, node);

	if (!port) {
		return -EINVAL;
	}

	switch (ptp_port_state(port)) {
	case PTP_PS_INITIALIZING:
	case PTP_PS_FAULTY:
	case PTP_PS_DISABLED:
	case PTP_PS_LISTENING:
	case PTP_PS_PRE_TIME_TRANSMITTER:
	case PTP_PS_PASSIVE:
	case PTP_PS_UNCALIBRATED:
		LOG_INF("FAIL");
		return 0;
	case PTP_PS_TIME_RECEIVER:
		LOG_INF("TIME RECEIVER");
		return 2;
	case PTP_PS_TIME_TRANSMITTER:
	case PTP_PS_GRAND_MASTER:
		LOG_INF("TIME TRANSMITTER");
		return 1;
	}

	return -1;
}

void init_testing(void)
{
	uint32_t uptime = k_uptime_get_32();
	int ret;

	if (run_duration == 0) {
		LOG_INF("Runs forever");
		return;
	}

	LOG_INF("Stopping after %u seconds", run_duration);

	k_sem_init(&quit_lock, 0, K_SEM_MAX_LIMIT);

	k_work_init_delayable(&stop_sample, stop_handler);
	k_work_reschedule(&stop_sample, K_SECONDS(run_duration));

	k_sem_take(&quit_lock, K_FOREVER);

	LOG_INF("Stopped after %u seconds", (k_uptime_get_32() - uptime) / 1000);

	/* Try to figure out what is the sync state.
	 * Return:
	 *  <0 - configuration error
	 *   0 - not time sync
	 *   1 - we are TimeTransmitter
	 *   2 - we are TimeReceiver
	 */
	ret = get_current_status();

	/* sleep gives deferred logs time to flush */
	k_msleep(2000);
	exit(ret);
}

#ifdef CONFIG_PRECISION_TIMING_SHELL
#define PHC_WAIT_ATTEMPTS 100U
#define PHC_WAIT_INTERVAL K_MSEC(100)

static struct precision_clock_ptp_adapter phc_adapter;

static int register_precision_clock(void)
{
	const struct device *ptp_clock;

	for (uint32_t attempt = 0U; attempt < PHC_WAIT_ATTEMPTS; attempt++) {
		struct net_if *iface = net_if_get_default();

		if (iface != NULL) {
			ptp_clock = net_eth_get_ptp_clock(iface);
			if (ptp_clock != NULL && device_is_ready(ptp_clock)) {
				precision_clock_ptp_init(&phc_adapter, ptp_clock);
				return precision_timing_shell_register(
					"phc", precision_clock_ptp_get(&phc_adapter));
			}
		}

		k_sleep(PHC_WAIT_INTERVAL);
	}

	return -ENODEV;
}
#endif

int main(void)
{
#ifdef CONFIG_PRECISION_TIMING_SHELL
	int ret = register_precision_clock();

	if (ret < 0) {
		LOG_ERR("Failed to register precision clock: %d", ret);
		return ret;
	}
#endif

	init_testing();
	return 0;
}
```
